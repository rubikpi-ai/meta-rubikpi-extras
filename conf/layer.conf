## conf/layer.conf
```bitbake
# We have a conf and classes directory, add to BBPATH
BBPATH .= ":${LAYERDIR}"

# We have a packages directory, add to BBFILES
BBFILES += "${LAYERDIR}/recipes-*/*/*.bb \
            ${LAYERDIR}/recipes-*/*/*.bbappend"

BBFILE_COLLECTIONS      += "rubikpi-extras"
BBFILE_PATTERN_rubikpi-extras   = "^${LAYERDIR}/"
BBFILE_PRIORITY_rubikpi-extras  = "10"

LAYERDEPENDS_qcom-extras = "rubikpi"
LAYERSERIES_COMPAT_qcom-extras = "kirkstone"
```
